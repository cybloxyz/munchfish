// =====================================================================
//  MUNCHFISH KEYCHAIN  -  @nfnailalhusna
// =====================================================================
#include <Wire.h>
#include <Adafruit_GFX.h>
#include <Adafruit_SSD1306.h>

#define SCREEN_WIDTH 128
#define SCREEN_HEIGHT 64
#define OLED_SDA 8
#define OLED_SCK 9
#define BUZZER_PIN 6

const uint8_t BTN_PIN[4] = { 7, 3, 1, 0 };
enum { BTN_FEED = 0,   
       BTN_TEXT = 1,   
       BTN_GAME = 2,   
                       
       BTN_PET  = 3 }; 

const int BTN_TARGET_X[4] = {  0, 18, 67, 92 };
const int BTN_TARGET_Y[4] = { 24, 44, 44, 44 };

const char* TEXT_LINE_1 = "@nfnailalhusna";
const char* TEXT_LINE_2 = "munchfish keychain";

Adafruit_SSD1306 display(SCREEN_WIDTH, SCREEN_HEIGHT, &Wire, -1);

#define FISH_W 36
#define FISH_H 18

const unsigned char fishR_normal_0[] PROGMEM = {
  0xC0, 0x00, 0x7C, 0xE0, 0x00,
  0xE0, 0x00, 0xFF, 0xF0, 0x00,
  0xE0, 0x00, 0xFF, 0xFC, 0x00,
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  0x00, 0x00, 0x0F, 0xC0, 0x00,
};

const unsigned char fishR_normal_1[] PROGMEM = {
  0x00, 0x00, 0x7C, 0xE0, 0x00,
  0x00, 0x00, 0xFF, 0xF0, 0x00,
  0x00, 0x00, 0xFF, 0xFC, 0x00,
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  0xC0, 0x00, 0x0F, 0xC0, 0x00,
};

const unsigned char fishR_happy_0[] PROGMEM = {
  0xC0, 0x00, 0x7C, 0xE0, 0x00,
  0xE0, 0x00, 0xFF, 0xF0, 0x00,
  0xE0, 0x00, 0xFF, 0xFC, 0x00,
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  0x00, 0x00, 0x0F, 0xC0, 0x00,
};

const unsigned char fishR_happy_1[] PROGMEM = {
  0x00, 0x00, 0x7C, 0xE0, 0x00,
  0x00, 0x00, 0xFF, 0xF0, 0x00,
  0x00, 0x00, 0xFF, 0xFC, 0x00,
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  0xC0, 0x00, 0x0F, 0xC0, 0x00,
};

const unsigned char fishR_angry_0[] PROGMEM = {
  0xC0, 0x00, 0x7C, 0xE0, 0x00,
  0xE0, 0x00, 0xFF, 0xF0, 0x00,
  0xE0, 0x00, 0xFF, 0xBC, 0x00,
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  0x00, 0x00, 0x0F, 0xC0, 0x00,
};

const unsigned char fishR_angry_1[] PROGMEM = {
  0x00, 0x00, 0x7C, 0xE0, 0x00,
  0x00, 0x00, 0xFF, 0xF0, 0x00,
  0x00, 0x00, 0xFF, 0xBC, 0x00,
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  0xC0, 0x00, 0x0F, 0xC0, 0x00,
};

const unsigned char fishR_eat_0[] PROGMEM = {
  0xC0, 0x00, 0x7C, 0xE0, 0x00,
  0xE0, 0x00, 0xFF, 0xF0, 0x00,
  0xE0, 0x00, 0xFF, 0xFC, 0x00,
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  0x00, 0x00, 0x0F, 0xC0, 0x00,
};

const unsigned char fishR_eat_1[] PROGMEM = {
  0x00, 0x00, 0x7C, 0xE0, 0x00,
  0x00, 0x00, 0xFF, 0xF0, 0x00,
  0x00, 0x00, 0xFF, 0xFC, 0x00,
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  0xC0, 0x00, 0x0F, 0xC0, 0x00,
};

const unsigned char maskR_0[] PROGMEM = {
  0xF0, 0x01, 0xFF, 0xF8, 0x00,
  0xF0, 0x01, 0xFF, 0xFE, 0x00,
  0xF8, 0x07, 0xFF, 0xFF, 0x80,
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  0x00, 0x01, 0xFF, 0xFE, 0x00,
};

const unsigned char maskR_1[] PROGMEM = {
  0x00, 0x01, 0xFF, 0xF8, 0x00,
  0x00, 0x01, 0xFF, 0xFE, 0x00,
  0x00, 0x07, 0xFF, 0xFF, 0x80,
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  0xF0, 0x01, 0xFF, 0xFE, 0x00,
};

const unsigned char fishL_normal_0[] PROGMEM = {
  0x00, 0x73, 0xE0, 0x00, 0x30,
  0x00, 0xFF, 0xF0, 0x00, 0x70,
  0x03, 0xFF, 0xF0, 0x00, 0x70,
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  0x00, 0x3F, 0x00, 0x00, 0x00,
};

const unsigned char fishL_normal_1[] PROGMEM = {
  0x00, 0x73, 0xE0, 0x00, 0x00,
  0x00, 0xFF, 0xF0, 0x00, 0x00,
  0x03, 0xFF, 0xF0, 0x00, 0x00,
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  0x00, 0x3F, 0x00, 0x00, 0x30,
};

const unsigned char fishL_happy_0[] PROGMEM = {
  0x00, 0x73, 0xE0, 0x00, 0x30,
  0x00, 0xFF, 0xF0, 0x00, 0x70,
  0x03, 0xFF, 0xF0, 0x00, 0x70,
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  0x00, 0x3F, 0x00, 0x00, 0x00,
};

const unsigned char fishL_happy_1[] PROGMEM = {
  0x00, 0x73, 0xE0, 0x00, 0x00,
  0x00, 0xFF, 0xF0, 0x00, 0x00,
  0x03, 0xFF, 0xF0, 0x00, 0x00,
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  0x00, 0x3F, 0x00, 0x00, 0x30,
};

const unsigned char fishL_angry_0[] PROGMEM = {
  0x00, 0x73, 0xE0, 0x00, 0x30,
  0x00, 0xFF, 0xF0, 0x00, 0x70,
  0x03, 0xDF, 0xF0, 0x00, 0x70,
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  0x00, 0x3F, 0x00, 0x00, 0x00,
};

const unsigned char fishL_angry_1[] PROGMEM = {
  0x00, 0x73, 0xE0, 0x00, 0x00,
  0x00, 0xFF, 0xF0, 0x00, 0x00,
  0x03, 0xDF, 0xF0, 0x00, 0x00,
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  0x00, 0x3F, 0x00, 0x00, 0x30,
};

const unsigned char fishL_eat_0[] PROGMEM = {
  0x00, 0x73, 0xE0, 0x00, 0x30,
  0x00, 0xFF, 0xF0, 0x00, 0x70,
  0x03, 0xFF, 0xF0, 0x00, 0x70,
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  0x00, 0x3F, 0x00, 0x00, 0x00,
};

const unsigned char fishL_eat_1[] PROGMEM = {
  0x00, 0x73, 0xE0, 0x00, 0x00,
  0x00, 0xFF, 0xF0, 0x00, 0x00,
  0x03, 0xFF, 0xF0, 0x00, 0x00,
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  0x00, 0x3F, 0x00, 0x00, 0x30,
};

const unsigned char maskL_0[] PROGMEM = {
  0x01, 0xFF, 0xF8, 0x00, 0xF0,
  0x07, 0xFF, 0xF8, 0x00, 0xF0,
  0x1F, 0xFF, 0xFE, 0x01, 0xF0,
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  0x07, 0xFF, 0xF8, 0x00, 0x00,
};

const unsigned char maskL_1[] PROGMEM = {
  0x01, 0xFF, 0xF8, 0x00, 0x00,
  0x07, 0xFF, 0xF8, 0x00, 0x00,
  0x1F, 0xFF, 0xFE, 0x00, 0x00,
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  0x07, 0xFF, 0xF8, 0x00, 0xF0,
};

enum Expr { EX_NORMAL = 0, EX_HAPPY = 1, EX_ANGRY = 2, EX_EAT = 3 };

const unsigned char* const FISH_BMP[2][4][2] = {
  { {fishR_normal_0, fishR_normal_1}, {fishR_happy_0, fishR_happy_1},
    {fishR_angry_0,  fishR_angry_1},  {fishR_eat_0,   fishR_eat_1} },
  { {fishL_normal_0, fishL_normal_1}, {fishL_happy_0, fishL_happy_1},
    {fishL_angry_0,  fishL_angry_1},  {fishL_eat_0,   fishL_eat_1} }
};
const unsigned char* const FISH_MASK[2][2] = {
  { maskR_0, maskR_1 },
  { maskL_0, maskL_1 }
};

#define FISH_MIN_X 0
#define FISH_MAX_X (SCREEN_WIDTH - FISH_W)
#define FISH_MIN_Y 3
#define FISH_MAX_Y (SCREEN_HEIGHT - FISH_H - 2)
#define FOOD_FLOOR 54

enum Mode { SWIM, HAPPY, ANGRY, EATING, GAME_READY, GAME_PLAY, GAME_OVER };
Mode mode = SWIM;
unsigned long modeStart = 0;

inline bool inGame() { return mode == GAME_READY || mode == GAME_PLAY || mode == GAME_OVER; }

struct Fish {
  float x, y;     
  float tx, ty;    
  int dir;        
};
Fish fish = {46, 22, 46, 22, 1};

unsigned long nextTargetTime = 0;
unsigned long lastFishFrame = 0;
uint8_t fishFrame = 0;
unsigned long lastFrameTime = 0;

#define MAX_BUBBLES 6
struct Bubble { float x, y, speed; uint8_t r; bool active; };
Bubble bubbles[MAX_BUBBLES];
unsigned long lastHappyBubble = 0;

// pelet ikan
#define MAX_FOOD 4
struct Food { float x, y; bool active; };
Food foods[MAX_FOOD];

// makan (kunyah + bunyi)
unsigned long lastChew = 0;
const int chewInterval = 250;
bool mouthOpen = false;
const unsigned long eatDuration = 800;

// input
bool btnDown[4]   = {false, false, false, false};
bool btnPrev[4]   = {false, false, false, false};
unsigned long btnPressStart[4] = {0, 0, 0, 0};
bool gameLongTriggered = false;
const unsigned long LONG_PRESS_MS = 900;
int pressedIdx = -1;             // tombol yang lagi ditekan (-1 = gak ada)

const unsigned long happyDuration = 3000;
const unsigned long angryDuration = 3000;

// ---- sistem reminder makan ----
const char* mealNames[3] = {"Sarapan", "Makan Siang", "Makan Sore"};
int mealIndex = 0;

unsigned long nextReminderTime;
bool reminderActive = false;
const unsigned long mealResetInterval = 4UL * 60 * 60 * 1000; // 4 jam
const unsigned long snoozeInterval = 30UL * 60 * 1000;        // snooze normal: 30 menit
const unsigned long shortSnoozeInterval = 5UL * 60 * 1000;    // snooze ke-3: 5 menit aja

int snoozeCount = 0;
const int maxSnoozeBeforeAngry = 3;

// ---- overlay teks (maks 2 baris) ----
bool showOverlay = false;
String overlayLine1 = "";
String overlayLine2 = "";
unsigned long overlayStart = 0;
const unsigned long overlayDuration = 2500;

// ---- mini game: flappy fish ----
// (satuan waktu: 1 unit = 16 ms, jadi kecepatan game sama di FPS berapa pun)
#define MAX_PIPES 3
struct Pipe { float x; int gapY; bool passed; bool active; };
Pipe pipes[MAX_PIPES];

const int   GAME_FISH_X  = 20;
const float GAME_G       = 0.16f;   // gravitasi
const float GAME_FLAP    = -1.8f;   // dorongan ke atas tiap tekan
const float GAME_VMAX    = 3.5f;    // kecepatan jatuh maksimum
const float GAME_SPEED   = 0.95f;   // kecepatan pipa
const int   GAME_GAP     = 38;      // tinggi celah pipa
const int   PIPE_W       = 12;
const int   PIPE_SPACING = 80;      // jarak antar pipa
const int   GAME_FLOOR   = 61;
// hitbox dibikin lebih kecil dari bitmap biar adil (koordinat dalam bitmap)
const int HB_X0 = 12, HB_X1 = 32, HB_Y0 = 4, HB_Y1 = 14;

float gameY = 22, gameVy = 0;
int   score = 0, bestScore = 0;

void showMessage(String line1, String line2 = "") {
  showOverlay = true;
  overlayStart = millis();
  overlayLine1 = line1;
  overlayLine2 = line2;
}

void spawnBubble(float x, float y) {
  for (int i = 0; i < MAX_BUBBLES; i++) {
    if (!bubbles[i].active) {
      bubbles[i].x = x;
      bubbles[i].y = y;
      bubbles[i].speed = 0.3f + random(0, 5) / 10.0f;
      bubbles[i].r = random(1, 3);
      bubbles[i].active = true;
      return;
    }
  }
}

// keluarin 3 pelet berurutan dari sisi tombol makan
void spawnFood() {
  float dispenserX = BTN_TARGET_X[BTN_FEED] + FISH_W / 2.0f;
  int spawned = 0;
  for (int i = 0; i < MAX_FOOD && spawned < 3; i++) {
    if (!foods[i].active) {
      foods[i].x = constrain(dispenserX + random(-10, 11), 4, SCREEN_WIDTH - 4);
      foods[i].y = -spawned * 9.0f;          
      foods[i].active = true;
      spawned++;
    }
  }
}

int nearestFood() {
  float cx = fish.x + FISH_W / 2.0f;
  float cy = fish.y + FISH_H / 2.0f;
  int best = -1;
  float bestDist = 1e9;
  for (int i = 0; i < MAX_FOOD; i++) {
    if (!foods[i].active) continue;
    float dx = foods[i].x - cx;
    float dy = foods[i].y - cy;
    float d = sqrt(dx * dx + dy * dy);
    if (d < bestDist) { bestDist = d; best = i; }
  }
  return best;
}

void pickNewTarget(unsigned long now) {
  fish.tx = random(FISH_MIN_X, FISH_MAX_X + 1);
  fish.ty = random(FISH_MIN_Y, FISH_MAX_Y + 1);
  if (mode == SWIM) nextTargetTime = now + random(1500, 4500);
  else              nextTargetTime = now + random(400, 900);  
}

void setMode(Mode m, unsigned long now) {
  mode = m;
  modeStart = now;
  if (m == SWIM || m == HAPPY || m == ANGRY) pickNewTarget(now);
}

void spawnPipe(float x) {
  for (int i = 0; i < MAX_PIPES; i++) {
    if (!pipes[i].active) {
      pipes[i].x = x;
      pipes[i].gapY = random(GAME_GAP / 2 + 5, GAME_FLOOR - GAME_GAP / 2);
      pipes[i].passed = false;
      pipes[i].active = true;
      return;
    }
  }
}

void startGame(unsigned long now) {
  for (int i = 0; i < MAX_FOOD; i++) foods[i].active = false;
  for (int i = 0; i < MAX_BUBBLES; i++) bubbles[i].active = false;
  for (int i = 0; i < MAX_PIPES; i++) pipes[i].active = false;
  reminderActive = reminderActive;          // reminder tetap nunggu sampai game selesai
  mode = GAME_READY;
  modeStart = now;
  gameY = 22;
  gameVy = 0;
  score = 0;
  fish.dir = 1;
  tone(BUZZER_PIN, 1000, 80);
  showMessage("Flappy Fish!", "Tekan tombol 3");
}

void flap() {
  gameVy = GAME_FLAP;
  fishFrame = 1;
  tone(BUZZER_PIN, 700, 25);
}

void crash(unsigned long now) {
  mode = GAME_OVER;
  modeStart = now;
  if (score > bestScore) bestScore = score;
  tone(BUZZER_PIN, 250, 400);
  showMessage("Game Over!", "Skor " + String(score) + "  Best " + String(bestScore));
}

void endGame(unsigned long now) {
  fish.x = GAME_FISH_X;
  fish.y = constrain(gameY, FISH_MIN_Y, FISH_MAX_Y);
  fish.dir = 1;
  showOverlay = false;
  setMode(SWIM, now);
}

void updateGame(unsigned long now, float dt) {
  if (mode == GAME_READY) {
    gameY = 22 + sin(now / 300.0) * 3;     
    if (now - lastFishFrame > 220) { fishFrame ^= 1; lastFishFrame = now; }
    return;
  }

  if (mode == GAME_OVER) {
    gameVy = min(GAME_VMAX, gameVy + GAME_G * dt);
    gameY += gameVy * dt;
    if (gameY > FISH_MAX_Y) gameY = FISH_MAX_Y;
    if (now - modeStart > overlayDuration) endGame(now);
    return;
  }

  gameVy = min(GAME_VMAX, gameVy + GAME_G * dt);
  gameY += gameVy * dt;

  if (now - lastFishFrame > 130) { fishFrame ^= 1; lastFishFrame = now; }

  float rightmost = -1000;
  bool any = false;
  for (int i = 0; i < MAX_PIPES; i++) {
    if (!pipes[i].active) continue;
    pipes[i].x -= GAME_SPEED * dt;
    if (pipes[i].x < -PIPE_W - 4) { pipes[i].active = false; continue; }
    any = true;
    if (pipes[i].x > rightmost) rightmost = pipes[i].x;
  }
  if (!any || rightmost < SCREEN_WIDTH - PIPE_SPACING) spawnPipe(SCREEN_WIDTH);

  // tabrakan & skor
  float hx0 = GAME_FISH_X + HB_X0, hx1 = GAME_FISH_X + HB_X1;
  float hy0 = gameY + HB_Y0,       hy1 = gameY + HB_Y1;
  if (hy0 <= 0 || hy1 >= GAME_FLOOR) { crash(now); return; }

  for (int i = 0; i < MAX_PIPES; i++) {
    if (!pipes[i].active) continue;
    float px = pipes[i].x;
    if (hx1 > px && hx0 < px + PIPE_W) {
      if (hy0 < pipes[i].gapY - GAME_GAP / 2 || hy1 > pipes[i].gapY + GAME_GAP / 2) {
        crash(now);
        return;
      }
    }
    if (!pipes[i].passed && px + PIPE_W < hx0) {
      pipes[i].passed = true;
      score++;
      tone(BUZZER_PIN, 1400, 40);
    }
  }
}

void setup() {
  Serial.begin(115200);
  Wire.begin(OLED_SDA, OLED_SCK);
  if (!display.begin(SSD1306_SWITCHCAPVCC, 0x3C)) {
    Serial.println("OLED gagal init, cek kabel SDA/SCL/VCC/GND");
    for(;;);
  }
  display.clearDisplay();

  for (int i = 0; i < 4; i++) pinMode(BTN_PIN[i], INPUT_PULLUP);

  randomSeed(micros());
  for (int i = 0; i < MAX_BUBBLES; i++) bubbles[i].active = false;
  for (int i = 0; i < MAX_FOOD; i++) foods[i].active = false;
  for (int i = 0; i < MAX_PIPES; i++) pipes[i].active = false;

  unsigned long now = millis();
  lastFrameTime = now;
  pickNewTarget(now);
  nextReminderTime = now + mealResetInterval;
}

void doSnooze(unsigned long now) {
  if (!reminderActive) return;
  reminderActive = false;
  snoozeCount++;

  if (snoozeCount >= maxSnoozeBeforeAngry) {
    nextReminderTime = now + shortSnoozeInterval;
    setMode(ANGRY, now);
    tone(BUZZER_PIN, 300, 400);
    snoozeCount = 0;
  } else {
    nextReminderTime = now + snoozeInterval;
    tone(BUZZER_PIN, 1200, 150);
  }

  mealIndex = (mealIndex + 1) % 3;
  showOverlay = false;
}

void updateInputs(unsigned long now) {
  bool pressedEdge[4], releasedEdge[4];
  for (int i = 0; i < 4; i++) {
    btnDown[i] = (digitalRead(BTN_PIN[i]) == LOW);
    pressedEdge[i]  = btnDown[i] && !btnPrev[i];
    releasedEdge[i] = !btnDown[i] && btnPrev[i];
    if (pressedEdge[i]) btnPressStart[i] = now;
    btnPrev[i] = btnDown[i];
  }

  if (inGame()) {
    pressedIdx = -1;
    if (pressedEdge[BTN_GAME]) {
      if (mode == GAME_READY) {
        mode = GAME_PLAY;
        modeStart = now;
        showOverlay = false;
        spawnPipe(SCREEN_WIDTH);
        flap();
      } else if (mode == GAME_PLAY) {
        flap();
      }
    }
    if (releasedEdge[BTN_GAME]) gameLongTriggered = false;
    if (showOverlay && mode != GAME_OVER && now - overlayStart > overlayDuration) showOverlay = false;
    return;
  }

  pressedIdx = -1;
  for (int i = 0; i < 4; i++) {
    if (btnDown[i]) { pressedIdx = i; break; }
  }

  if (pressedEdge[BTN_FEED]) {
    spawnFood();
    tone(BUZZER_PIN, 800, 100);
  }

  if (pressedEdge[BTN_TEXT]) {
    showMessage(TEXT_LINE_1, TEXT_LINE_2);
  }

  if (pressedEdge[BTN_PET] && mode != EATING && mode != ANGRY) {
    setMode(HAPPY, now);
    tone(BUZZER_PIN, 1500, 80);
  }

  if (btnDown[BTN_GAME] && !gameLongTriggered && now - btnPressStart[BTN_GAME] >= LONG_PRESS_MS) {
    gameLongTriggered = true;
    startGame(now);
    return;
  }
  if (releasedEdge[BTN_GAME]) {
    if (!gameLongTriggered) doSnooze(now);
    gameLongTriggered = false;
  }

  if (!reminderActive && now >= nextReminderTime) {
    reminderActive = true;
    tone(BUZZER_PIN, 400, 500);
    showMessage("Waktunya makan:", String(mealNames[mealIndex]) + "!");
  }

  if (showOverlay && now - overlayStart > overlayDuration) {
    showOverlay = false;
  }
}

void updateFish(unsigned long now, float dt) {
  if (mode == HAPPY && now - modeStart > happyDuration) setMode(SWIM, now);
  if (mode == ANGRY && now - modeStart > angryDuration) setMode(SWIM, now);
  if (mode == EATING && now - modeStart > eatDuration) setMode(SWIM, now);

  for (int i = 0; i < MAX_FOOD; i++) {
    if (!foods[i].active) continue;
    foods[i].y += 0.5f * dt;
    if (foods[i].y > FOOD_FLOOR) foods[i].y = FOOD_FLOOR;
  }

  int foodIdx = nearestFood();
  bool chasingFood = false;

  if (mode == EATING) {
  } else if (pressedIdx >= 0) {
    fish.tx = BTN_TARGET_X[pressedIdx];
    fish.ty = BTN_TARGET_Y[pressedIdx];
    nextTargetTime = now + 1500;             =
  } else if (foodIdx >= 0) {
    chasingFood = true;
    float fx = foods[foodIdx].x;
    float costR = (fx >= FISH_W - 3 + FISH_MIN_X) ? fabs((fx - (FISH_W - 3)) - fish.x) : 1e9f;
    float costL = (fx - 2 <= FISH_MAX_X)          ? fabs((fx - 2) - fish.x)             : 1e9f;
    if (fish.dir > 0) costR -= 6; else costL -= 6;    
    fish.dir = (costR < costL) ? 1 : -1;          
    float mouthOffset = (fish.dir > 0) ? (FISH_W - 3) : 2;
    fish.tx = constrain(fx - mouthOffset, FISH_MIN_X, FISH_MAX_X);
    fish.ty = constrain(foods[foodIdx].y - FISH_H * 0.55f, FISH_MIN_Y, FISH_MAX_Y);
  } else if (now >= nextTargetTime) {
    pickNewTarget(now);
  }

  float speed = 0.55f;
  if (mode == HAPPY) speed = 1.4f;
  if (mode == ANGRY) speed = 2.2f;
  if (pressedIdx >= 0 && mode == SWIM) speed = 1.3f;
  if (chasingFood) speed = 1.2f;
  if (mode == EATING) speed = 0;

  float dx = fish.tx - fish.x;
  float dy = fish.ty - fish.y;
  float dist = sqrt(dx * dx + dy * dy);
  float step = speed * dt;
  if (speed > 0) {
    if (dist > step) {
      fish.x += dx / dist * step;
      fish.y += dy / dist * step;
    } else {
      fish.x = fish.tx;
      fish.y = fish.ty;
    }
  }
  if (!chasingFood && fabs(dx) > 3) fish.dir = (dx > 0) ? 1 : -1;

  fish.x = constrain(fish.x, FISH_MIN_X, FISH_MAX_X);
  fish.y = constrain(fish.y, FISH_MIN_Y, FISH_MAX_Y);

  if (mode != EATING) {
    float mx = fish.x + ((fish.dir > 0) ? (FISH_W - 3) : 2);
    float my = fish.y + FISH_H * 0.55f;
    for (int i = 0; i < MAX_FOOD; i++) {
      if (!foods[i].active || foods[i].y < 0) continue;
      float fx = foods[i].x - mx;
      float fy = foods[i].y - my;
      if (sqrt(fx * fx + fy * fy) < 7) {
        foods[i].active = false;
        setMode(EATING, now);
        lastChew = 0;
        break;
      }
    }
  }

  unsigned long frameInterval = 220;
  if (mode == HAPPY) frameInterval = 110;
  if (mode == ANGRY) frameInterval = 70;
  if (mode == EATING) frameInterval = 150;
  if (now - lastFishFrame > frameInterval) {
    fishFrame ^= 1;
    lastFishFrame = now;
  }

  if (mode == EATING && now - lastChew > chewInterval) {
    mouthOpen = !mouthOpen;
    lastChew = now;
    tone(BUZZER_PIN, mouthOpen ? 900 : 600, 80);
  }

  if (mode == HAPPY && now - lastHappyBubble > 250) {
    lastHappyBubble = now;
    float bx = (fish.dir > 0) ? fish.x + FISH_W : fish.x - 2;
    spawnBubble(bx, fish.y + 4);
  }
  if (random(0, 200) == 0) spawnBubble(random(4, SCREEN_WIDTH - 4), SCREEN_HEIGHT - 4);

  for (int i = 0; i < MAX_BUBBLES; i++) {
    if (!bubbles[i].active) continue;
    bubbles[i].y -= bubbles[i].speed * dt;
    if (bubbles[i].y < 0) bubbles[i].active = false;
  }
}

void drawSand() {
  display.drawFastHLine(0, 63, SCREEN_WIDTH, SSD1306_WHITE);
  for (int x = 1; x < SCREEN_WIDTH; x += 3) display.drawPixel(x, 62, SSD1306_WHITE);
  const int dots[] = {7, 29, 53, 77, 101, 123};
  for (int i = 0; i < 6; i++) display.drawPixel(dots[i], 61, SSD1306_WHITE);
}

void drawRock(int cx, int r) {
  display.fillCircle(cx, 63, r, SSD1306_WHITE);
  display.drawPixel(cx - 1, 63 - r + 2, SSD1306_BLACK);  
  display.drawPixel(cx,     63 - r + 2, SSD1306_BLACK);
}

void drawSeaweed(int baseX, int h, float phase, unsigned long now) {
  float t = now / 450.0f;
  int px = baseX, py = 62;
  for (int i = 1; i <= h; i += 3) {
    float sway = sin(t + phase + i * 0.22f) * (1.0f + i * 0.09f);
    int nx = baseX + (int)(sway + (sway >= 0 ? 0.5f : -0.5f));
    int ny = 62 - i;
    display.drawLine(px, py, nx, ny, SSD1306_WHITE);
    display.drawLine(px + 1, py, nx + 1, ny, SSD1306_WHITE);
    if ((i / 3) % 2 == 0) display.drawLine(nx + 1, ny, nx + 4, ny - 2, SSD1306_WHITE);   
    else                  display.drawLine(nx, ny, nx - 3, ny - 2, SSD1306_WHITE);
    px = nx; py = ny;
  }
}

void drawStarfish(int cx, int cy) {
  display.drawLine(cx, cy, cx,     cy - 3, SSD1306_WHITE);
  display.drawLine(cx, cy, cx + 3, cy - 1, SSD1306_WHITE);
  display.drawLine(cx, cy, cx + 2, cy + 2, SSD1306_WHITE);
  display.drawLine(cx, cy, cx - 2, cy + 2, SSD1306_WHITE);
  display.drawLine(cx, cy, cx - 3, cy - 1, SSD1306_WHITE);
}

void drawAquarium(unsigned long now) {
  drawSand();
  drawSeaweed(8,   26, 0.0f, now);
  drawSeaweed(92,  17, 3.1f, now);
  drawSeaweed(119, 22, 1.7f, now);
  drawRock(18, 5);
  drawRock(25, 3);
  drawRock(106, 4);
  drawStarfish(62, 59);
}

void drawBubbles() {
  for (int i = 0; i < MAX_BUBBLES; i++) {
    if (bubbles[i].active) {
      display.drawCircle((int)bubbles[i].x, (int)bubbles[i].y, bubbles[i].r, SSD1306_WHITE);
    }
  }
}

void drawFood() {
  for (int i = 0; i < MAX_FOOD; i++) {
    if (foods[i].active && foods[i].y >= 0) {
      display.fillCircle((int)foods[i].x, (int)foods[i].y, 2, SSD1306_WHITE);
    }
  }
}

void drawPipes() {
  for (int i = 0; i < MAX_PIPES; i++) {
    if (!pipes[i].active) continue;
    int x = (int)pipes[i].x;
    int topH = pipes[i].gapY - GAME_GAP / 2;     
    int botY = pipes[i].gapY + GAME_GAP / 2;      
    // tiang atas
    display.drawRect(x, -1, PIPE_W, topH + 1, SSD1306_WHITE);
    display.drawRect(x - 2, topH - 4, PIPE_W + 4, 4, SSD1306_WHITE);
    // tiang bawah
    display.drawRect(x, botY, PIPE_W, 64 - botY, SSD1306_WHITE);
    display.drawRect(x - 2, botY, PIPE_W + 4, 4, SSD1306_WHITE);
    // tekstur
    for (int y = 3; y < topH - 4; y += 4) display.drawPixel(x + 3, y, SSD1306_WHITE);
    for (int y = botY + 7; y < 62; y += 4) display.drawPixel(x + 3, y, SSD1306_WHITE);
  }
}

void drawFishSprite(int x, int y, int dir, Expr ex) {
  int d = (dir > 0) ? 0 : 1;
  display.drawBitmap(x, y, FISH_MASK[d][fishFrame], FISH_W, FISH_H, SSD1306_BLACK);
  display.drawBitmap(x, y, FISH_BMP[d][ex][fishFrame], FISH_W, FISH_H, SSD1306_WHITE);
}

void drawFish() {
  int x = (int)fish.x;
  int y = (int)fish.y;
  Expr ex = EX_NORMAL;

  if (mode == EATING) {
    y += mouthOpen ? 1 : 0;                    
    ex = mouthOpen ? EX_EAT : EX_NORMAL;
  } else {
    y += (int)(sin(millis() / 350.0) * 1.5);  
  }
  if (mode == HAPPY) ex = EX_HAPPY;
  if (mode == ANGRY) {
    ex = EX_ANGRY;
    x += random(-1, 2);                       
    y += random(-1, 2);
  }
  drawFishSprite(x, y, fish.dir, ex);
}

void drawGameFish() {
  Expr ex = (mode == GAME_OVER) ? EX_ANGRY : EX_NORMAL;
  drawFishSprite(GAME_FISH_X, (int)gameY, 1, ex);
}

void drawScore() {
  String s = String(score);
  int16_t x1, y1;
  uint16_t w, h;
  display.setTextSize(1);
  display.getTextBounds(s, 0, 0, &x1, &y1, &w, &h);
  int bx = (SCREEN_WIDTH - w) / 2 - 3;
  display.fillRect(bx, 0, w + 6, h + 4, SSD1306_BLACK);
  display.drawRect(bx, 0, w + 6, h + 4, SSD1306_WHITE);
  display.setTextColor(SSD1306_WHITE);
  display.setCursor(bx + 3, 2);
  display.print(s);
}

void drawOverlay() {
  display.setTextSize(1);
  display.setTextColor(SSD1306_WHITE);

  int16_t x1, y1;
  uint16_t w1 = 0, h1 = 0, w2 = 0, h2 = 0;
  display.getTextBounds(overlayLine1, 0, 0, &x1, &y1, &w1, &h1);
  bool twoLines = (overlayLine2.length() > 0);
  if (twoLines) display.getTextBounds(overlayLine2, 0, 0, &x1, &y1, &w2, &h2);

  int boxW = max((int)w1, (int)w2) + 8;
  int boxH = twoLines ? (h1 + h2 + 2 + 8) : (h1 + 8);
  int boxX = (SCREEN_WIDTH - boxW) / 2;
  int boxY = (SCREEN_HEIGHT - boxH) / 2;

  display.fillRect(boxX, boxY, boxW, boxH, SSD1306_BLACK);
  display.drawRect(boxX, boxY, boxW, boxH, SSD1306_WHITE);

  display.setCursor((SCREEN_WIDTH - w1) / 2, boxY + 4);
  display.print(overlayLine1);
  if (twoLines) {
    display.setCursor((SCREEN_WIDTH - w2) / 2, boxY + 4 + h1 + 2);
    display.print(overlayLine2);
  }
}

void loop() {
  unsigned long now = millis();
  float dt = (now - lastFrameTime) / 16.0f;     
  if (dt > 2.0f) dt = 2.0f;                    
  lastFrameTime = now;

  updateInputs(now);
  if (inGame()) updateGame(now, dt);
  else          updateFish(now, dt);

  display.clearDisplay();
  if (inGame()) {
    drawSand();
    drawPipes();
    drawGameFish();
    if (mode == GAME_PLAY) drawScore();
  } else {
    drawAquarium(now);
    drawBubbles();
    drawFood();
    drawFish();
  }
  if (showOverlay) drawOverlay();
  display.display();

  delay(10);
}
